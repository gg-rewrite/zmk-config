## boards/shields/magpie_5/Kconfig.defconfig
```kconfig
if SHIELD_MAGPIE_5_LEFT

config ZMK_KEYBOARD_NAME
    default "magpie-5"

config ZMK_SPLIT_ROLE_CENTRAL
    default y

endif # SHIELD_MAGPIE_5_LEFT

if SHIELD_MAGPIE_5_LEFT || SHIELD_MAGPIE_5_RIGHT

config ZMK_SPLIT
    default y

endif # SHIELD_MAGPIE_5_LEFT || SHIELD_MAGPIE_5_RIGHT
```

## boards/shields/magpie_5/Kconfig.shield
```kconfig
config SHIELD_MAGPIE_5_LEFT
    def_bool $(shields_list_contains,magpie_5_left)

config SHIELD_MAGPIE_5_RIGHT
    def_bool $(shields_list_contains,magpie_5_right)
```
