// This file was generated from a template. Edit it to match your keyboard.
// See https://zmk.dev/docs/development/hardware-integration/new-shield for more
// instructions.

#include "magpie_5.dtsi"
#include "trackball-3610.dtsi"
/* #include "trackball-3360.dtsi" */
#include <dt-bindings/zmk/mouse.h>

&default_transform {
	col-offset = <7>;
};
	
&right_encoder {
	status = "okay";
};


/ {
	trackball_listener {
		compatible = "zmk,input-listener";
		device = <&trackball>;

	};
};
